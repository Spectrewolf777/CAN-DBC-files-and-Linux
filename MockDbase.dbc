VERSION ""

NS_ :

BS_:

BU_:
VAL_TABLE_ BatteryState 2 "Error" 1 "Battery Enabled" 0 "Battery Disabled" ;

BO_ 18 BatteryInfo: 8 Vector__XXX
 SG_ BatteryVoltage : 24|16@1- (0.01,0) [3|4.2] "" Vector__XXX
 SG_ BatteryState : 0|8@1- (1,0) [0|3] "" Vector__XXX

BA_DEF_  "BusType" STRING ;
BA_DEF_DEF_  "BusType" "CAN";
VAL_ 18 BatteryState 2 "Error" 1 "Battery Enabled" 0 "Battery Disabled" ;
